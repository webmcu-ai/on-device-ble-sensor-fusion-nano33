// ======================================================
// ARDUINO NANO 33 BLE SENSE
// FULL SENSOR FUSION - BLE PERIPHERAL - v11
// (nano33-sensor-fusion-ble-peripheral-v11)
//
// Role: PERIPHERAL. Advertises a BLE service, waits for the XIAO
// ESP32S3 (the CENTRAL / controller) to connect and write commands,
// then samples every onboard sensor into one fused window and
// streams it back as chunked binary. Sampling/BLE unchanged from v04.
//
// NEW IN v11 - FIXED MODEL PUSH HANGING AFTER THE FIRST CHUNK:
//   The ~500ms heartbeat notify was firing WHILE a chunked model write
//   from the browser was still in flight. A notify landing on the
//   connection while a write is outstanding is a known way to stall
//   that write indefinitely on some OS Bluetooth stacks - this matched
//   exactly what was being seen ("Model RX: 180/23488 bytes (0%)" then
//   nothing). The heartbeat is now suppressed for the duration of a
//   model push, and a 5s stale-transfer watchdog resets myModelRxActive
//   if a push ever does stall, so a retry isn't permanently blocked.
//
// NEW IN v09 - OPTIONAL BAKED-IN MODEL (still never trains on-device):
//   A #define USE_BAKED_WEIGHTS block near the top of this file can
//   now #include "myFusionWeights.h" (generated by index-v09.html's
//   new "Save myWeights.h" button) so the board boots with a model
//   already loaded instead of waiting for a BLE push. A later BLE
//   push still works exactly as before and simply replaces it.
//
// NEW IN v08 - USB SERIAL MENU (mirrors esp32_v08.ino's menu):
//   The Nano33 previously had NO Serial Monitor menu at all - it only
//   reacted to BLE commands from a connected central. It now prints
//   the same style of menu on boot / on demand and accepts single-key
//   commands over USB Serial, independent of whether a BLE central is
//   connected:
//     i = Infer once/continuous  (real 1s window, 'x' to stop)
//     q = Quick continuous infer (fast replicated reading, 'x' to stop)
//     s = status
//     z = reset (restart the board)
//     ? = this menu
//   Training is still NOT available on this board (by design, unchanged)
//   so there is no 't' menu item here. 'i'/'q' reuse the exact same
//   sampling + forward-pass + BLE-notify code path that BLE's
//   INFER/QUICKINFER commands already used in v05-v07 (now factored
//   into myActionInferOnce()/myActionQuickInferOnce() so both entry
//   points - Serial and BLE - stay in sync). If no model has been
//   pushed yet, 'i'/'q' will say so instead of silently doing nothing.
//
// NEW IN v05 - ON-DEVICE INFERENCE (NO TRAINING):
//   Per your instructions, the Nano33 NEVER trains. It can now,
//   however, RECEIVE a fully-trained model (weights + calibration)
//   pushed over BLE from either the ESP32 (which already trains) or
//   the webpage (which can now also train, browser-side, using the
//   same architecture - see index-v02.html). Once a model is loaded
//   it can run a local forward pass and report the result, so
//   inference is no longer ESP32-only.
//
//   Two new characteristics (UUIDs ...af20 family, same service):
//     MODEL_CHAR  (write, chunked)  - central pushes a model package
//     RESULT_CHAR (notify)          - Nano33 reports inference results
//
//   Two new control commands, additive to CAPTURE/QUICK:
//     "INFER"      - sample a full 1s window (same as CAPTURE, and
//                    still sends the raw window binary so the
//                    central can log/train on it too), THEN if a
//                    model is loaded, run a local forward pass and
//                    notify the result.
//     "QUICKINFER" - single instant reading (same as QUICK, still
//                    sends the raw QUICK binary), THEN local forward
//                    pass + result notify if a model is loaded.
//   CAPTURE and QUICK behave exactly as in v04 (raw data only, no
//   inference attempted) - existing central-side collection code
//   needs zero changes.
//
// MODEL PACKAGE WIRE FORMAT (float32LE, must match ESP32/webpage
// exactly - see "PROTOCOL CONTRACT" block below):
//   conv1_w(400), conv1_b(8), dense1_w(4832), dense1_b(32),
//   dense2_w(512), dense2_b(16), output_w(48), output_b(3),
//   calibMean(10), calibStd(10)
//   = 5871 floats = 23484 bytes total.
//   Sent with the same 4-byte-LE-length-header + chunk pattern as
//   the existing binary window transfer, just reversed in direction
//   (central -> peripheral, WRITE instead of INDICATE).
//
// RESULT NOTIFY FORMAT (compact CSV text, index-based so the
// central's own class-label strings are always authoritative):
//   "predIdx,confidence,p0,p1,p2,...,pN-1"
//   e.g. "1,0.82,0.05,0.82,0.13"
//
// Everything else (sensor sampling, static context, heartbeat) is
// unchanged from v04.
//
// By Jeremy Ellis
// With free tier assistance from: Claude (code overview), ChatGPT (Critique),
//   Gemini (Research) and Copilot (Alternate)
// Use at your own risk!
// MIT license
//
// Github Profile https://github.com/hpssjellis
// LinkedIn https://www.linkedin.com/in/jeremy-ellis-4237a9bb/
//
// Arduino IDE: install "ArduinoBLE" by Arduino, plus the standard
// Nano 33 BLE Sense sensor libraries (PDM, Arduino_LSM9DS1,
// Arduino_APDS9960, Arduino_LPS22HB, Arduino_HTS221) via Library Manager.
// ======================================================

#include <PDM.h>
#include <Arduino_LSM9DS1.h>
#include <Arduino_APDS9960.h>
#include <Arduino_LPS22HB.h>
#include <Arduino_HTS221.h>
#include <ArduinoBLE.h>

// ======================================================
// [NEW v09] OPTIONAL BAKED-IN MODEL - lets this board boot with a
// model already loaded instead of always waiting for a BLE push.
//
// Workflow: train in the browser (index-v08.html / index-v09.html),
// click "Save myWeights.h (Arduino Include)", drop the downloaded
// file next to THIS .ino, renamed to exactly "myFusionWeights.h",
// uncomment the #define below, and re-upload. A later BLE push (the
// MODEL_CHAR path, unchanged) still works normally afterwards and
// simply overwrites the baked-in weights in RAM - baking just avoids
// starting from "no model loaded" every power-cycle.
//
// myFusionWeights.h (as generated by the webpage) defines:
//   #define MY_BAKED_NUM_CLASSES <N>
//   const float myModel_conv1_w[]    = { ... };   // CONV1_WEIGHTS   (400)
//   const float myModel_conv1_b[]    = { ... };   // CONV1_FILTERS   (8)
//   const float myModel_dense1_w[]   = { ... };   // DENSE1_WEIGHTS  (4832)
//   const float myModel_dense1_b[]   = { ... };   // DENSE1_SIZE     (32)
//   const float myModel_dense2_w[]   = { ... };   // DENSE2_WEIGHTS  (512)
//   const float myModel_dense2_b[]   = { ... };   // DENSE2_SIZE     (16)
//   const float myModel_output_w[]   = { ... };   // DENSE2_SIZE * MY_BAKED_NUM_CLASSES
//   const float myModel_output_b[]   = { ... };   // MY_BAKED_NUM_CLASSES
//   const float myModel_calibMean[]  = { ... };   // FAST_CHANNELS   (10)
//   const float myModel_calibStd[]   = { ... };   // FAST_CHANNELS   (10)
// (identical array-name convention to esp32_v08.ino's own SD-card
// header export, plus the two calib arrays this board also needs -
// the ESP32 doesn't bake calib in because it self-calibrates from the
// Nano33 at boot instead.) The actual memcpy-into-live-arrays happens
// near the end of setup() below, once myConv1_w etc are declared and
// MY_MAX_CLASSES is known, so it can range-check MY_BAKED_NUM_CLASSES
// against it first.
// ======================================================
//#define USE_BAKED_WEIGHTS
#ifdef USE_BAKED_WEIGHTS
  #include "myFusionWeights.h"
#endif

// ======================================================
// BLE CONFIGURATION - keep these UUIDs identical on the ESP32S3 and
// webpage side
// ======================================================
#define MY_BLE_DEVICE_NAME        "Nano33-Fusion-01"

#define MY_BLE_SERVICE_UUID        "7e400001-b2c3-5d4e-af60-9b3c7d8eaf20"
#define MY_BLE_CONTROL_CHAR_UUID   "7e400002-b2c3-5d4e-af60-9b3c7d8eaf20"  // Write:  central -> Nano33 commands
#define MY_BLE_HEARTBEAT_CHAR_UUID "7e400003-b2c3-5d4e-af60-9b3c7d8eaf20"  // Notify: Nano33 -> central live compact status
#define MY_BLE_BINARY_CHAR_UUID    "7e400004-b2c3-5d4e-af60-9b3c7d8eaf20"  // Indicate: Nano33 -> central fused window, chunked
#define MY_BLE_MODEL_CHAR_UUID     "7e400005-b2c3-5d4e-af60-9b3c7d8eaf20"  // Write (chunked): central -> Nano33, pushes a trained model+calib package [NEW v05]
#define MY_BLE_RESULT_CHAR_UUID    "7e400006-b2c3-5d4e-af60-9b3c7d8eaf20"  // Notify: Nano33 -> central, on-device inference result [NEW v05]

#define MY_BLE_CHUNK_SIZE   180     // bytes per binary notify/write (safe under default MTU)
#define MY_BLE_CONTROL_MAXLEN 32
#define MY_BLE_HEARTBEAT_MAXLEN 64
#define MY_BLE_RESULT_MAXLEN 96

BLEService myFusionService(MY_BLE_SERVICE_UUID);
BLECharacteristic myControlChar(MY_BLE_CONTROL_CHAR_UUID, BLEWrite, MY_BLE_CONTROL_MAXLEN);
BLECharacteristic myHeartbeatChar(MY_BLE_HEARTBEAT_CHAR_UUID, BLENotify, MY_BLE_HEARTBEAT_MAXLEN);
BLECharacteristic myBinaryChar(MY_BLE_BINARY_CHAR_UUID, BLEIndicate, MY_BLE_CHUNK_SIZE);
BLECharacteristic myModelChar(MY_BLE_MODEL_CHAR_UUID, BLEWrite | BLEWriteWithoutResponse, MY_BLE_CHUNK_SIZE);   // [NEW v05]
BLECharacteristic myResultChar(MY_BLE_RESULT_CHAR_UUID, BLENotify, MY_BLE_RESULT_MAXLEN);                        // [NEW v05]
// BLEIndicate (not BLENotify) for the binary window char: indications
// are acknowledged by the central before the next writeValue() call
// can proceed - Notify has no flow control and drops packets under
// load. Same reasoning does NOT apply to myModelChar because there
// the Nano33 is the *receiver* - flow control there is naturally
// provided by BLE's own write queue on the central side, which is
// why WriteWithoutResponse (faster) is offered as an option too.

// ======================================================
// WINDOW / SENSOR CONFIG (unchanged from v04)
// ======================================================
#define IMU_TIMESTEPS       40
#define FAST_CHANNELS       10     // ax,ay,az,gx,gy,gz,mx,my,mz,mic
#define STATIC_FEATURES      7     // pressure,temp,humid,prox,r,g,b
#define SAMPLE_INTERVAL_MS  25     // ~40 Hz, matches motion-anomaly-v010

#define FAST_SIZE   (IMU_TIMESTEPS * FAST_CHANNELS)          // 400
#define PACKET_FLOATS (FAST_SIZE + STATIC_FEATURES)          // 407
#define PACKET_BYTES  (PACKET_FLOATS * 4)                    // 1628

#define QUICK_PACKET_FLOATS  (FAST_CHANNELS + STATIC_FEATURES)  // 17
#define QUICK_PACKET_BYTES   (QUICK_PACKET_FLOATS * 4)          // 68

float myPacketBuf[PACKET_FLOATS];        // reused every full-window capture
float myQuickBuf[QUICK_PACKET_FLOATS];   // reused every quick read

// ======================================================
// PART A: ON-DEVICE INFERENCE ENGINE [NEW v05]
// Forward-pass only, no gradients, no backward pass, no training.
// Architecture MUST match esp32-v05.ino and index-v02.html exactly:
//   Conv1D(k=5,f=8) -> MaxPool/2 -> flatten(144) ++ static(7)
//   = 151 -> Dense(32) -> Dense(16) -> Output(N classes, softmax)
// ======================================================
#define MY_MAX_CLASSES        8     // upper bound - actual count comes from the model package header
#define CONV1_KERNEL           5
#define CONV1_FILTERS           8
#define CONV1_OUT_STEPS  (IMU_TIMESTEPS - CONV1_KERNEL + 1)   // 36
#define POOL1_STEPS      (CONV1_OUT_STEPS / 2)                // 18
#define CONV1_FLAT       (POOL1_STEPS * CONV1_FILTERS)        // 144
#define COMBINED_SIZE    (CONV1_FLAT + STATIC_FEATURES)       // 151
#define CONV1_WEIGHTS    (CONV1_KERNEL * FAST_CHANNELS * CONV1_FILTERS)  // 400

#define DENSE1_SIZE   32
#define DENSE2_SIZE   16

#define DENSE1_WEIGHTS  (COMBINED_SIZE * DENSE1_SIZE)   // 151 x 32 = 4832
#define DENSE2_WEIGHTS  (DENSE1_SIZE  * DENSE2_SIZE)    //  32 x 16 = 512
// OUTPUT_WEIGHTS / OUTPUT_BIAS depend on NUM_CLASSES which travels
// inside the model package (see PROTOCOL CONTRACT below), so those
// are sized to MY_MAX_CLASSES and only the first myNumClasses rows
// are used - keeps this sketch working even if you change class
// count on the ESP32/webpage side without touching this file.
#define OUTPUT_WEIGHTS_MAX  (DENSE2_SIZE * MY_MAX_CLASSES)   // 16 x 8 = 128

// ======================================================
// PROTOCOL CONTRACT - model package layout, float32LE, must match
// esp32-v05.ino's mySaveWeights()/myExportModelPackage() and
// index-v02.html's myExportModelPackage() bit-for-bit:
//   [0]                     numClasses (as a float, e.g. 3.0f)  [NEW v05 header float]
//   conv1_w   (400)
//   conv1_b   (8)
//   dense1_w  (4832)
//   dense1_b  (32)
//   dense2_w  (512)
//   dense2_b  (16)
//   output_w  (DENSE2_SIZE * numClasses)
//   output_b  (numClasses)
//   calibMean (FAST_CHANNELS = 10)
//   calibStd  (FAST_CHANNELS = 10)
// Max total (at MY_MAX_CLASSES=8) = 1+400+8+4832+32+512+16+128+8+10+10
//                                  = 5957 floats = 23828 bytes
// ======================================================
#define MY_MODEL_PACKAGE_MAXFLOATS (1 + CONV1_WEIGHTS + CONV1_FILTERS + DENSE1_WEIGHTS + DENSE1_SIZE + \
                                     DENSE2_WEIGHTS + DENSE2_SIZE + OUTPUT_WEIGHTS_MAX + MY_MAX_CLASSES + \
                                     FAST_CHANNELS + FAST_CHANNELS)
#define MY_MODEL_PACKAGE_MAXBYTES (MY_MODEL_PACKAGE_MAXFLOATS * 4)   // 23828

float myConv1_w[CONV1_WEIGHTS];
float myConv1_b[CONV1_FILTERS];
float myDense1_w[DENSE1_WEIGHTS];
float myDense1_b[DENSE1_SIZE];
float myDense2_w[DENSE2_WEIGHTS];
float myDense2_b[DENSE2_SIZE];
float myOutput_w[OUTPUT_WEIGHTS_MAX];
float myOutput_b[MY_MAX_CLASSES];
float myCalibMean[FAST_CHANNELS];
float myCalibStd[FAST_CHANNELS];
int   myNumClasses = 0;      // 0 = no model loaded yet
bool  myModelLoaded = false;

// forward-pass scratch buffers
float myConv1_output[CONV1_OUT_STEPS * CONV1_FILTERS];
float myPool1_output[CONV1_FLAT];
float myCombined[COMBINED_SIZE];
float myDense1_output[DENSE1_SIZE];
float myDense2_output[DENSE2_SIZE];
float myFinal_output[MY_MAX_CLASSES];

// Optional local labels, ONLY used for Serial pretty-printing on this
// board. The BLE result notify is index-based so the central (which
// always owns the authoritative label list) never depends on this.
// TUNE-ME: keep in sync with esp32-v05.ino's myClassLabels if you
// want the Nano33's own Serial Monitor to show real names too.
String myLocalLabels[MY_MAX_CLASSES] = {"0unknown", "1normal", "2issue", "", "", "", "", ""};

inline float myLeakyRelu(float x) { return x > 0 ? x : 0.1f * x; }

void mySoftmax(float* x, int size) {
  float maxVal = x[0];
  for (int i = 1; i < size; i++) if (x[i] > maxVal) maxVal = x[i];
  float sum = 0;
  for (int i = 0; i < size; i++) { x[i] = exp(x[i] - maxVal); sum += x[i]; }
  for (int i = 0; i < size; i++) x[i] /= sum;
}

inline float myClip(float v, float mn = -5.0f, float mx = 5.0f) {
  if (isnan(v) || isinf(v)) return 0;
  return v < mn ? mn : (v > mx ? mx : v);
}

// Static-feature normalization constants - MUST match esp32-v05.ino's
// MY_PRESSURE_BASELINE etc exactly (these are fixed, not learned, so
// they are not part of the model package).
#define MY_PRESSURE_BASELINE   101.0f
#define MY_PRESSURE_SCALE        5.0f
#define MY_TEMP_BASELINE        20.0f
#define MY_TEMP_SCALE           10.0f
#define MY_HUMIDITY_BASELINE     50.0f
#define MY_HUMIDITY_SCALE       25.0f
#define MY_PROX_SCALE           255.0f
#define MY_COLOR_SCALE          255.0f

// buf must be PACKET_FLOATS long (full window layout); normalizes in place
void myNormalizeWindow(float* buf) {
  for (int t = 0; t < IMU_TIMESTEPS; t++) {
    for (int c = 0; c < FAST_CHANNELS; c++) {
      int idx = t * FAST_CHANNELS + c;
      buf[idx] = myClip((buf[idx] - myCalibMean[c]) / (myCalibStd[c] + 1e-8f));
    }
  }
  buf[FAST_SIZE + 0] = myClip((buf[FAST_SIZE + 0] - MY_PRESSURE_BASELINE) / MY_PRESSURE_SCALE);
  buf[FAST_SIZE + 1] = myClip((buf[FAST_SIZE + 1] - MY_TEMP_BASELINE)     / MY_TEMP_SCALE);
  buf[FAST_SIZE + 2] = myClip((buf[FAST_SIZE + 2] - MY_HUMIDITY_BASELINE) / MY_HUMIDITY_SCALE);
  buf[FAST_SIZE + 3] = myClip(buf[FAST_SIZE + 3] / MY_PROX_SCALE,  0, 5);
  buf[FAST_SIZE + 4] = myClip(buf[FAST_SIZE + 4] / MY_COLOR_SCALE, 0, 5);
  buf[FAST_SIZE + 5] = myClip(buf[FAST_SIZE + 5] / MY_COLOR_SCALE, 0, 5);
  buf[FAST_SIZE + 6] = myClip(buf[FAST_SIZE + 6] / MY_COLOR_SCALE, 0, 5);
}

// Builds a full PACKET_FLOATS window by replicating one QUICK reading
// across all IMU_TIMESTEPS - same trick esp32 uses for its "q" mode.
void myBuildWindowFromQuick(float* outBuf, float* quickBuf) {
  for (int t = 0; t < IMU_TIMESTEPS; t++) {
    memcpy(outBuf + t * FAST_CHANNELS, quickBuf, FAST_CHANNELS * sizeof(float));
  }
  memcpy(outBuf + FAST_SIZE, quickBuf + FAST_CHANNELS, STATIC_FEATURES * sizeof(float));
}

void myForwardPass(float* normalizedWindow) {
  // Conv1D
  for (int s = 0; s < CONV1_OUT_STEPS; s++) {
    for (int f = 0; f < CONV1_FILTERS; f++) {
      float sum = myConv1_b[f];
      for (int k = 0; k < CONV1_KERNEL; k++) {
        for (int c = 0; c < FAST_CHANNELS; c++) {
          sum += normalizedWindow[(s + k) * FAST_CHANNELS + c] *
                 myConv1_w[(k * FAST_CHANNELS + c) * CONV1_FILTERS + f];
        }
      }
      myConv1_output[s * CONV1_FILTERS + f] = myLeakyRelu(sum);
    }
  }
  // MaxPool /2
  for (int s = 0; s < POOL1_STEPS; s++) {
    for (int f = 0; f < CONV1_FILTERS; f++) {
      float a = myConv1_output[(s * 2)     * CONV1_FILTERS + f];
      float b = myConv1_output[(s * 2 + 1) * CONV1_FILTERS + f];
      myPool1_output[s * CONV1_FILTERS + f] = a > b ? a : b;
    }
  }
  // Concat flatten ++ static
  memcpy(myCombined, myPool1_output, CONV1_FLAT * sizeof(float));
  memcpy(myCombined + CONV1_FLAT, normalizedWindow + FAST_SIZE, STATIC_FEATURES * sizeof(float));
  // Dense1
  for (int j = 0; j < DENSE1_SIZE; j++) {
    float sum = myDense1_b[j];
    for (int i = 0; i < COMBINED_SIZE; i++) sum += myCombined[i] * myDense1_w[i * DENSE1_SIZE + j];
    myDense1_output[j] = myLeakyRelu(sum);
  }
  // Dense2
  for (int j = 0; j < DENSE2_SIZE; j++) {
    float sum = myDense2_b[j];
    for (int i = 0; i < DENSE1_SIZE; i++) sum += myDense1_output[i] * myDense2_w[i * DENSE2_SIZE + j];
    myDense2_output[j] = myLeakyRelu(sum);
  }
  // Output
  for (int j = 0; j < myNumClasses; j++) {
    float sum = myOutput_b[j];
    for (int i = 0; i < DENSE2_SIZE; i++) sum += myDense2_output[i] * myOutput_w[i * myNumClasses + j];
    myFinal_output[j] = sum;
  }
  mySoftmax(myFinal_output, myNumClasses);
}

void myRunInferenceAndReport(float* rawWindow) {
  if (!myModelLoaded) {
    Serial.println("Infer requested but no model loaded yet - waiting for MODEL_CHAR push (from ESP32 or browser).");
    return;
  }
  float buf[PACKET_FLOATS];
  memcpy(buf, rawWindow, PACKET_BYTES);
  myNormalizeWindow(buf);
  myForwardPass(buf);

  int pred = 0;
  for (int j = 1; j < myNumClasses; j++) if (myFinal_output[j] > myFinal_output[pred]) pred = j;

  // BLE result notify: index-based CSV, "predIdx,conf,p0,p1,...pN-1"
  char out[MY_BLE_RESULT_MAXLEN];
  int n = snprintf(out, sizeof(out), "%d,%.3f", pred, myFinal_output[pred]);
  for (int j = 0; j < myNumClasses && n < (int)sizeof(out) - 8; j++) {
    n += snprintf(out + n, sizeof(out) - n, ",%.3f", myFinal_output[j]);
  }
  Serial.print("Central subscribed to result char? ");
  Serial.println(myResultChar.subscribed() ? "YES" : "NO - central will not see this result on the webpage!");
  myResultChar.writeValue((const uint8_t*)out, n);

  Serial.print("On-device inference: ");
  if (myLocalLabels[pred].length() > 0) { Serial.print(myLocalLabels[pred]); }
  else { Serial.print("class#"); Serial.print(pred); }
  Serial.print("  conf=");
  Serial.print(myFinal_output[pred] * 100.0f, 1);
  Serial.println("%");
}

// ======================================================
// SHARED INFER ACTIONS [NEW v08] - one body each, called from BOTH
// the BLE control-char handler (INFER/QUICKINFER, unchanged behavior)
// AND the new Serial menu ('i'/'q'), so the two entry points can never
// drift apart. Still shares the raw window over BLE (myBLESendPacket /
// myBLESendBuffer) even when triggered from Serial with no central
// connected - ArduinoBLE's writeValue()/notify() are safe no-ops in
// that case, and it means a central that connects mid-session still
// sees the same behavior it always did.
// ======================================================
void myActionInferOnce() {
  Serial.println("\n>>> Infer - sampling real 1s window...");
  mySampleFullWindow();
  myBLESendPacket();
  myRunInferenceAndReport(myPacketBuf);
}

void myActionQuickInferOnce() {
  mySampleQuick();
  myBLESendBuffer((const uint8_t*)myQuickBuf, QUICK_PACKET_BYTES);
  float windowBuf[PACKET_FLOATS];
  myBuildWindowFromQuick(windowBuf, myQuickBuf);
  myRunInferenceAndReport(windowBuf);
}

// ======================================================
// PART B: MODEL RECEIVE (chunked write, central -> Nano33) [NEW v05]
// Mirrors the existing binary-SEND state machine but reversed:
// first write = 4-byte LE total length, then raw chunks until full.
// ======================================================
uint8_t myModelRxBuf[MY_MODEL_PACKAGE_MAXBYTES];
volatile bool myModelRxActive = false;
volatile uint32_t myModelRxTotal = 0;
volatile uint32_t myModelRxGot   = 0;
volatile unsigned long myModelRxLastByteMs = 0;   // [NEW v11] stale-transfer watchdog

void myUnpackModel() {
  float* f = (float*)myModelRxBuf;
  int idx = 0;
  myNumClasses = (int)(f[idx++] + 0.5f);
  if (myNumClasses < 1 || myNumClasses > MY_MAX_CLASSES) {
    Serial.print("ERROR: model package numClasses out of range: ");
    Serial.println(myNumClasses);
    myModelLoaded = false;
    return;
  }
  memcpy(myConv1_w,  f + idx, CONV1_WEIGHTS  * 4); idx += CONV1_WEIGHTS;
  memcpy(myConv1_b,  f + idx, CONV1_FILTERS  * 4); idx += CONV1_FILTERS;
  memcpy(myDense1_w, f + idx, DENSE1_WEIGHTS * 4); idx += DENSE1_WEIGHTS;
  memcpy(myDense1_b, f + idx, DENSE1_SIZE    * 4); idx += DENSE1_SIZE;
  memcpy(myDense2_w, f + idx, DENSE2_WEIGHTS * 4); idx += DENSE2_WEIGHTS;
  memcpy(myDense2_b, f + idx, DENSE2_SIZE    * 4); idx += DENSE2_SIZE;
  int outW = DENSE2_SIZE * myNumClasses;
  memcpy(myOutput_w, f + idx, outW * 4); idx += outW;
  memcpy(myOutput_b, f + idx, myNumClasses * 4); idx += myNumClasses;
  memcpy(myCalibMean, f + idx, FAST_CHANNELS * 4); idx += FAST_CHANNELS;
  memcpy(myCalibStd,  f + idx, FAST_CHANNELS * 4); idx += FAST_CHANNELS;

  myModelLoaded = true;
  Serial.print("Model package received and loaded - numClasses=");
  Serial.print(myNumClasses);
  Serial.print("  total bytes=");
  Serial.println(myModelRxTotal);
}

void myOnModelWrite(BLEDevice central, BLECharacteristic characteristic) {
  int len = myModelChar.valueLength();
  const uint8_t* data = myModelChar.value();

  if (!myModelRxActive) {
    if (len == 4) {
      myModelRxTotal = (uint32_t)data[0] | ((uint32_t)data[1] << 8) |
                        ((uint32_t)data[2] << 16) | ((uint32_t)data[3] << 24);
      if (myModelRxTotal > MY_MODEL_PACKAGE_MAXBYTES) {
        Serial.print("ERROR: model package too large for buffer: ");
        Serial.println(myModelRxTotal);
        return;
      }
      myModelRxGot = 0;
      myModelRxActive = true;
      myModelRxLastByteMs = millis();
      Serial.print("Model push starting, expecting ");
      Serial.print(myModelRxTotal);
      Serial.println(" bytes");
    } else {
      Serial.println("Model write: unexpected first packet (wanted 4-byte length header) - ignoring");
    }
    return;
  }

  uint32_t room = myModelRxTotal - myModelRxGot;
  uint32_t n = min((uint32_t)len, room);
  memcpy(myModelRxBuf + myModelRxGot, data, n);
  myModelRxGot += n;
  myModelRxLastByteMs = millis();   // [NEW v11]

  // [NEW v09] progress feedback - previously this was silent between the
  // "starting" and "complete" prints, which on a slow/flaky BLE link could
  // look identical to a push that silently died partway through.
  static uint8_t myLastPct = 255;
  uint8_t myPct = (uint8_t)((myModelRxGot * 100UL) / myModelRxTotal);
  if (myPct != myLastPct && (myPct % 10 == 0 || myModelRxGot >= myModelRxTotal)) {
    Serial.print("Model RX: ");
    Serial.print(myModelRxGot);
    Serial.print("/");
    Serial.print(myModelRxTotal);
    Serial.print(" bytes (");
    Serial.print(myPct);
    Serial.println("%)");
    myLastPct = myPct;
  }

  if (myModelRxGot >= myModelRxTotal) {
    myModelRxActive = false;
    myLastPct = 255;
    myLastHeartbeatMs = millis();   // [NEW v11] give the link a clean gap before the next heartbeat resumes
    Serial.println("Model push complete - unpacking...");
    myUnpackModel();
  }
}

// ======================================================
// MIC (PDM) ROLLING LEVEL - unchanged from v04
// ======================================================
short mySampleBuffer[256];
volatile int mySamplesRead = 0;
float myMicLevel = 0;

void onPDMdata() {
  int bytesAvailable = PDM.available();
  PDM.read(mySampleBuffer, bytesAvailable);
  mySamplesRead = bytesAvailable / 2;
}

void myUpdateMicLevel() {
  if (mySamplesRead > 0) {
    long total = 0;
    for (int i = 0; i < mySamplesRead; i++) total += abs(mySampleBuffer[i]);
    myMicLevel = (float)total / (float)mySamplesRead;
    mySamplesRead = 0;
  }
}

// ======================================================
// LAST-KNOWN IMU VALUES - unchanged from v04
// ======================================================
float myAx = 0, myAy = 0, myAz = 1.0f;
float myGx = 0, myGy = 0, myGz = 0;
float myMx = 0, myMy = 0, myMz = 0;

void myUpdateImuLatest() {
  if (IMU.accelerationAvailable())   IMU.readAcceleration(myAx, myAy, myAz);
  if (IMU.gyroscopeAvailable())      IMU.readGyroscope(myGx, myGy, myGz);
  if (IMU.magneticFieldAvailable())  IMU.readMagneticField(myMx, myMy, myMz);
}

// ======================================================
// STATE
// ======================================================
volatile bool myCaptureRequested = false;
volatile bool myQuickRequested = false;
volatile bool myInferRequested = false;       // [NEW v05] CAPTURE + local inference
volatile bool myQuickInferRequested = false;  // [NEW v05] QUICK + local inference
bool myCentralConnected = false;
unsigned long myLastHeartbeatMs = 0;
const unsigned long myHeartbeatIntervalMs = 500;

// ======================================================
// SERIAL MENU STATE [NEW v08] - mirrors esp32_v08.ino's MODE_MENU /
// MODE_INFER / MODE_QUICK_INFER pattern. No MODE_COLLECT / MODE_TRAIN
// here since this board never collects/trains, by design.
// ======================================================
enum MyLocalMode { MODE_MENU, MODE_INFER, MODE_QUICK_INFER };
MyLocalMode myLocalMode = MODE_MENU;
unsigned long myLastLocalInferMs = 0;
unsigned long myLastLocalQuickInferMs = 0;

float myLastPressure = 0, myLastTemp = 0, myLastHumidity = 0;
int   myLastProximity = 0, myLastColorR = 0, myLastColorG = 0, myLastColorB = 0;
int   myLastGesture = -1;

// ======================================================
// SERIAL MENU [NEW v08]
// ======================================================
void myPrintMenu() {
  Serial.println("\n=== Nano33 Menu ===");
  Serial.println("  i = Infer once/continuous (real 1s window, 'x' to stop)");
  Serial.println("  q = Quick continuous infer (fast, replicated single reading, 'x' to stop)");
  Serial.println("  s = status");
  Serial.println("  z = reset (restart this board)");
  Serial.println("  ? = this menu");
  Serial.println("  (Training is not available on this board - it only receives");
  Serial.println("   a model pushed over BLE from the ESP32S3 or the browser.)");
}

void myPrintStatus() {
  Serial.print("BLE central connected: ");
  Serial.println(myCentralConnected ? "yes" : "no");
  Serial.print("Model loaded: ");
  if (myModelLoaded) {
    Serial.print("yes - numClasses=");
    Serial.println(myNumClasses);
  } else {
    Serial.println("no");
  }
}

void myHandleMenuCommand(char cmd) {
  if (cmd == 'i') {
    myLocalMode = MODE_INFER;
    myLastLocalInferMs = 0;   // fire immediately, then every ~2s
    Serial.println("\n>>> Infer mode (press 'x' to exit) - real 1s window capture every ~2s");
  } else if (cmd == 'q') {
    myLocalMode = MODE_QUICK_INFER;
    myLastLocalQuickInferMs = 0;   // fire immediately, then every ~300ms
    Serial.println("\n>>> Quick infer mode (press 'x' to exit) - fast replicated reading");
  } else if (cmd == 's') {
    myPrintStatus();
  } else if (cmd == 'z') {
    Serial.println("Resetting now...");
    delay(200);
    NVIC_SystemReset();   // standard reset for the Nano 33 BLE's nRF52840/mbed core
  } else if (cmd == '?') {
    myPrintMenu();
  }
}

void myHandleLocalInferLoop() {
  while (Serial.available() && (Serial.peek() == '\n' || Serial.peek() == '\r')) Serial.read();
  if (Serial.available() && Serial.peek() == 'x') {
    Serial.read();
    myLocalMode = MODE_MENU;
    Serial.println("Exiting infer mode.");
    myPrintMenu();
    return;
  }
  unsigned long now = millis();
  if (now - myLastLocalInferMs >= 2000) {
    myLastLocalInferMs = now;
    myActionInferOnce();
  }
}

void myHandleLocalQuickInferLoop() {
  while (Serial.available() && (Serial.peek() == '\n' || Serial.peek() == '\r')) Serial.read();
  if (Serial.available() && Serial.peek() == 'x') {
    Serial.read();
    myLocalMode = MODE_MENU;
    Serial.println("Exiting quick infer mode.");
    myPrintMenu();
    return;
  }
  unsigned long now = millis();
  if (now - myLastLocalQuickInferMs >= 300) {   // quick reads are cheap, poll faster
    myLastLocalQuickInferMs = now;
    myActionQuickInferOnce();
  }
}

// ======================================================
// SETUP
// ======================================================
void setup() {
  Serial.begin(115200);
  unsigned long t0 = millis();
  while (!Serial && millis() - t0 < 3000) { /* wait briefly, don't hang forever */ }

  Serial.println("\n=== Nano 33 BLE Sense - Sensor Fusion BLE Peripheral v05 ===");
  Serial.println("Training: NOT available on this board (by design). Inference: available once a model is pushed.");

  PDM.onReceive(onPDMdata);
  if (!PDM.begin(1, 16000)) {
    Serial.println("ERROR: Failed to start PDM microphone!");
  }

  if (!IMU.begin()) {
    Serial.println("ERROR: Failed to initialize LSM9DS1 IMU!");
  } else {
    Serial.println("IMU (LSM9DS1) OK");
  }

  APDS.setGestureSensitivity(70);
  if (!APDS.begin()) {
    Serial.println("ERROR: Failed to initialize APDS9960!");
  } else {
    APDS.setLEDBoost(0);
    Serial.println("APDS9960 OK");
  }

  if (!BARO.begin()) {
    Serial.println("ERROR: Failed to initialize LPS22HB baro!");
  } else {
    Serial.println("LPS22HB OK");
  }

  if (!HTS.begin()) {
    Serial.println("ERROR: Failed to initialize HTS221!");
  } else {
    Serial.println("HTS221 OK");
  }

  if (!BLE.begin()) {
    Serial.println("FATAL: Failed to start BLE!");
    while (1) { delay(1000); }
  }

  BLE.setLocalName(MY_BLE_DEVICE_NAME);
  BLE.setDeviceName(MY_BLE_DEVICE_NAME);
  BLE.setAdvertisedService(myFusionService);

  myFusionService.addCharacteristic(myControlChar);
  myFusionService.addCharacteristic(myHeartbeatChar);
  myFusionService.addCharacteristic(myBinaryChar);
  myFusionService.addCharacteristic(myModelChar);   // [NEW v05]
  myFusionService.addCharacteristic(myResultChar);  // [NEW v05]
  BLE.addService(myFusionService);

  myControlChar.setEventHandler(BLEWritten, myOnControlWrite);
  myModelChar.setEventHandler(BLEWritten, myOnModelWrite);   // [NEW v05]

  BLE.advertise();
  Serial.print("BLE peripheral advertising as \"");
  Serial.print(MY_BLE_DEVICE_NAME);
  Serial.println("\"");
  Serial.println("Waiting for central to connect (ESP32S3, or a browser via index-v02.html)...");

  // ======================================================
  // [NEW v09] APPLY BAKED-IN WEIGHTS, IF ANY - see the USE_BAKED_WEIGHTS
  // block near the top of this file. Placed here (end of setup(), after
  // myConv1_w[] etc are declared) rather than right after the #include,
  // since that's the earliest point the target arrays and MY_MAX_CLASSES
  // actually exist. A later BLE model push still overwrites all of this
  // normally - baking just avoids "no model loaded" on a cold boot.
  // ======================================================
  #ifdef USE_BAKED_WEIGHTS
  {
    if (MY_BAKED_NUM_CLASSES < 1 || MY_BAKED_NUM_CLASSES > MY_MAX_CLASSES) {
      Serial.print("WARNING: myFusionWeights.h has MY_BAKED_NUM_CLASSES=");
      Serial.print(MY_BAKED_NUM_CLASSES);
      Serial.print(", must be between 1 and MY_MAX_CLASSES=");
      Serial.print(MY_MAX_CLASSES);
      Serial.println(" - skipping baked weights, waiting for a BLE push instead.");
    } else {
      memcpy(myConv1_w,  myModel_conv1_w,  CONV1_WEIGHTS  * sizeof(float));
      memcpy(myConv1_b,  myModel_conv1_b,  CONV1_FILTERS  * sizeof(float));
      memcpy(myDense1_w, myModel_dense1_w, DENSE1_WEIGHTS * sizeof(float));
      memcpy(myDense1_b, myModel_dense1_b, DENSE1_SIZE    * sizeof(float));
      memcpy(myDense2_w, myModel_dense2_w, DENSE2_WEIGHTS * sizeof(float));
      memcpy(myDense2_b, myModel_dense2_b, DENSE2_SIZE    * sizeof(float));
      memcpy(myOutput_w, myModel_output_w, DENSE2_SIZE * MY_BAKED_NUM_CLASSES * sizeof(float));
      memcpy(myOutput_b, myModel_output_b, MY_BAKED_NUM_CLASSES * sizeof(float));
      memcpy(myCalibMean, myModel_calibMean, FAST_CHANNELS * sizeof(float));
      memcpy(myCalibStd,  myModel_calibStd,  FAST_CHANNELS * sizeof(float));
      myNumClasses  = MY_BAKED_NUM_CLASSES;
      myModelLoaded = true;
      Serial.print("Baked-in weights loaded (");
      Serial.print(MY_BAKED_NUM_CLASSES);
      Serial.println(" classes) - Infer/QuickInfer work immediately, no BLE push needed.");
    }
  }
  #endif

  myPrintMenu();   // [NEW v08]
}

// ======================================================
// CONTROL CHARACTERISTIC CALLBACK
// ======================================================
void myOnControlWrite(BLEDevice central, BLECharacteristic characteristic) {
  int len = myControlChar.valueLength();
  char buf[MY_BLE_CONTROL_MAXLEN + 1];
  int n = min(len, MY_BLE_CONTROL_MAXLEN);
  memcpy(buf, myControlChar.value(), n);
  buf[n] = '\0';
  String cmd = String(buf);
  cmd.trim();

  Serial.print("Control RX: \"");
  Serial.print(cmd);
  Serial.println("\"");

  if (cmd == "CAPTURE") {
    myCaptureRequested = true;
  } else if (cmd == "QUICK") {
    myQuickRequested = true;
  } else if (cmd == "INFER") {          // [NEW v05]
    myInferRequested = true;
  } else if (cmd == "QUICKINFER") {     // [NEW v05]
    myQuickInferRequested = true;
  }
  // room for future commands - ignored for v05
}

// ======================================================
// STATIC CONTEXT READ - unchanged from v04
// ======================================================
void myReadStaticContext() {
  myLastPressure = BARO.readPressure();          // kPa
  myLastTemp     = HTS.readTemperature();         // C
  myLastHumidity = HTS.readHumidity();            // %

  if (APDS.proximityAvailable()) {
    myLastProximity = APDS.readProximity();
  }
  if (APDS.colorAvailable()) {
    APDS.readColor(myLastColorR, myLastColorG, myLastColorB);
  }
  if (APDS.gestureAvailable()) {
    myLastGesture = APDS.readGesture();
    Serial.print("Gesture event: ");
    Serial.print(myLastGesture);
    Serial.println(" (diagnostic only, not in ML window)");
  }
}

// ======================================================
// CAPTURE ONE FUSED WINDOW - unchanged sampling logic from v04,
// split into sample-only vs sample-and-send so INFER can reuse it.
// ======================================================
void mySampleFullWindow() {
  myReadStaticContext();

  for (int t = 0; t < IMU_TIMESTEPS; t++) {
    unsigned long tStart = millis();

    BLE.poll();
    myUpdateImuLatest();
    myUpdateMicLevel();

    int base = t * FAST_CHANNELS;
    myPacketBuf[base + 0] = myAx;
    myPacketBuf[base + 1] = myAy;
    myPacketBuf[base + 2] = myAz;
    myPacketBuf[base + 3] = myGx;
    myPacketBuf[base + 4] = myGy;
    myPacketBuf[base + 5] = myGz;
    myPacketBuf[base + 6] = myMx;
    myPacketBuf[base + 7] = myMy;
    myPacketBuf[base + 8] = myMz;
    myPacketBuf[base + 9] = myMicLevel;

    if (t % 10 == 0) {
      char lineBuf[110];
      snprintf(lineBuf, sizeof(lineBuf),
               "  t%02d: a=%.2f,%.2f,%.2f g=%.1f,%.1f,%.1f m=%.1f,%.1f,%.1f mic=%.0f",
               t, myAx, myAy, myAz, myGx, myGy, myGz, myMx, myMy, myMz, myMicLevel);
      Serial.println(lineBuf);
    }

    long elapsed = millis() - tStart;
    if (elapsed < SAMPLE_INTERVAL_MS) delay(SAMPLE_INTERVAL_MS - elapsed);
  }

  myPacketBuf[FAST_SIZE + 0] = myLastPressure;
  myPacketBuf[FAST_SIZE + 1] = myLastTemp;
  myPacketBuf[FAST_SIZE + 2] = myLastHumidity;
  myPacketBuf[FAST_SIZE + 3] = (float)myLastProximity;
  myPacketBuf[FAST_SIZE + 4] = (float)myLastColorR;
  myPacketBuf[FAST_SIZE + 5] = (float)myLastColorG;
  myPacketBuf[FAST_SIZE + 6] = (float)myLastColorB;

  char lineBuf[100];
  snprintf(lineBuf, sizeof(lineBuf),
           "Static context: pres=%.2f temp=%.2f hum=%.2f prox=%d rgb=%d,%d,%d",
           myLastPressure, myLastTemp, myLastHumidity,
           myLastProximity, myLastColorR, myLastColorG, myLastColorB);
  Serial.println(lineBuf);
}

void myCaptureAndSendWindow() {
  Serial.println("\n>>> CAPTURE requested - sampling fused window...");
  Serial.print("Central subscribed to binary char? ");
  Serial.println(myBinaryChar.subscribed() ? "YES" : "NO - central will not receive this window!");
  mySampleFullWindow();
  myBLESendPacket();
  Serial.println("Window sent.");
}

// ======================================================
// BLE SEND - unchanged from v04
// ======================================================
void myBLESendBuffer(const uint8_t* raw, uint32_t totalBytes) {
  uint8_t header[4];
  header[0] = (uint8_t)(totalBytes & 0xFF);
  header[1] = (uint8_t)((totalBytes >> 8) & 0xFF);
  header[2] = (uint8_t)((totalBytes >> 16) & 0xFF);
  header[3] = (uint8_t)((totalBytes >> 24) & 0xFF);

  myBinaryChar.writeValue(header, 4);
  BLE.poll();

  int chunkCount = 0;
  for (uint32_t offset = 0; offset < totalBytes; offset += MY_BLE_CHUNK_SIZE) {
    int n = min((uint32_t)MY_BLE_CHUNK_SIZE, totalBytes - offset);
    myBinaryChar.writeValue(raw + offset, n);
    BLE.poll();
    chunkCount++;
  }
  Serial.print("Sent ");
  Serial.print(totalBytes);
  Serial.print(" bytes in ");
  Serial.print(chunkCount);
  Serial.println(" chunks");
}

void myBLESendPacket() {
  myBLESendBuffer((const uint8_t*)myPacketBuf, PACKET_BYTES);
}

// ======================================================
// QUICK - unchanged from v04
// ======================================================
void mySampleQuick() {
  myUpdateImuLatest();
  myUpdateMicLevel();
  myReadStaticContext();

  myQuickBuf[0] = myAx; myQuickBuf[1] = myAy; myQuickBuf[2] = myAz;
  myQuickBuf[3] = myGx; myQuickBuf[4] = myGy; myQuickBuf[5] = myGz;
  myQuickBuf[6] = myMx; myQuickBuf[7] = myMy; myQuickBuf[8] = myMz;
  myQuickBuf[9] = myMicLevel;
  myQuickBuf[10] = myLastPressure;
  myQuickBuf[11] = myLastTemp;
  myQuickBuf[12] = myLastHumidity;
  myQuickBuf[13] = (float)myLastProximity;
  myQuickBuf[14] = (float)myLastColorR;
  myQuickBuf[15] = (float)myLastColorG;
  myQuickBuf[16] = (float)myLastColorB;
}

void myCaptureAndSendQuick() {
  mySampleQuick();
  myBLESendBuffer((const uint8_t*)myQuickBuf, QUICK_PACKET_BYTES);
}

// ======================================================
// HEARTBEAT - unchanged from v04
// ======================================================
void myBLESendHeartbeat() {
  myUpdateImuLatest();
  myUpdateMicLevel();
  char buf[MY_BLE_HEARTBEAT_MAXLEN];
  snprintf(buf, sizeof(buf), "%.2f,%.2f,%.2f,%.0f,%.1f,%.1f,%d",
           myAx, myAy, myAz, myMicLevel, myLastTemp, myLastHumidity, myLastProximity);
  myHeartbeatChar.writeValue((const uint8_t*)buf, strlen(buf));
}

// ======================================================
// LOOP
// ======================================================
void loop() {
  BLE.poll();

  // [NEW v11] STALE MODEL-PUSH WATCHDOG - if a chunked model write starts
  // but no further bytes arrive for 5s (browser tab closed, page reloaded,
  // BLE hiccup, etc), un-stick myModelRxActive so a fresh push attempt can
  // start cleanly instead of every subsequent write being silently treated
  // as "not the first packet" forever.
  if (myModelRxActive && (millis() - myModelRxLastByteMs > 5000)) {
    Serial.print("WARNING: model push stalled (");
    Serial.print(myModelRxGot);
    Serial.print("/");
    Serial.print(myModelRxTotal);
    Serial.println(" bytes, no data for 5s) - aborting, ready for a fresh push");
    myModelRxActive = false;
  }

  // [NEW v08] USB Serial menu - independent of BLE central connection
  // state. Only read Serial here while actually in the menu; while a
  // continuous mode is running, myHandleLocalInferLoop()/
  // myHandleLocalQuickInferLoop() own Serial exclusively so their
  // peek-for-'x' check is guaranteed to see the next byte typed
  // (reading it here first would swallow it before that check runs).
  if (myLocalMode == MODE_MENU) {
    if (Serial.available()) {
      char cmd = Serial.read();
      if (cmd == '\n' || cmd == '\r') { /* ignore */ }
      else myHandleMenuCommand(cmd);
    }
  }
  if (myLocalMode == MODE_INFER)       myHandleLocalInferLoop();
  if (myLocalMode == MODE_QUICK_INFER) myHandleLocalQuickInferLoop();

  BLEDevice central = BLE.central();
  if (central) {
    if (!myCentralConnected) {
      myCentralConnected = true;
      Serial.print("Central connected: ");
      Serial.println(central.address());
    }

    if (myCaptureRequested) {
      myCaptureRequested = false;
      myCaptureAndSendWindow();
    }
    if (myQuickRequested) {
      myQuickRequested = false;
      myCaptureAndSendQuick();
    }
    if (myInferRequested) {                       // [NEW v05] BLE-triggered
      myInferRequested = false;
      myActionInferOnce();             // [CHANGED v08] now shared with Serial menu 'i'
    }
    if (myQuickInferRequested) {                  // [NEW v05] BLE-triggered
      myQuickInferRequested = false;
      myActionQuickInferOnce();        // [CHANGED v08] now shared with Serial menu 'q'
    }

    unsigned long now = millis();
    // [CHANGED v11] Suppress the heartbeat notify while a model push is in
    // progress (myModelRxActive). A notify landing on the connection while
    // the browser has a chunked write outstanding is a known way to stall
    // that write indefinitely on some OS Bluetooth stacks - this was the
    // most likely cause of model pushes hanging after the very first chunk
    // (Serial showing "Model RX: 180/23488 bytes (0%)" and then nothing).
    if (!myModelRxActive && (now - myLastHeartbeatMs >= myHeartbeatIntervalMs)) {
      myLastHeartbeatMs = now;
      myBLESendHeartbeat();
    }
  } else if (myCentralConnected) {
    myCentralConnected = false;
    Serial.println("Central disconnected - re-advertising");
  }
}
